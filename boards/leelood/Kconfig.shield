## boards/leelood/Kconfig.shield
```kconfig
# Copyright (c) 2023 The ZMK Contributors
# SPDX-License-Identifier: MIT

config SHIELD_LEELOOD
    bool

config SHIELD_LEELOOD_CENTRAL
    def_bool $(shields_list_contains,leelood_central)

config SHIELD_LEELOOD_LEFT_CENTRAL
    def_bool $(shields_list_contains,leelood_left_central)

config SHIELD_LEELOOD_LEFT
    def_bool $(shields_list_contains,leelood_left)

config SHIELD_LEELOOD_RIGHT
    def_bool $(shields_list_contains,leelood_right)
```

## config/boards/leeloo/Kconfig.shield
```kconfig
# Copyright (c) 2023 The ZMK Contributors
# SPDX-License-Identifier: MIT

config SHIELD_LEELOO
    bool

config SHIELD_LEELOO_CENTRAL_DONGLE
    def_bool $(shields_list_contains,leeloo_central_dongle)

config SHIELD_LEELOO_CENTRAL_LEFT
    def_bool $(shields_list_contains,leeloo_central_left)

config SHIELD_LEELOO_PERIPHERAL_LEFT
    def_bool $(shields_list_contains,leeloo_peripheral_left)

config SHIELD_LEELOO_PERIPHERAL_RIGHT
    def_bool $(shields_list_contains,leeloo_peripheral_right)
```
